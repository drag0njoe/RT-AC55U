## release/src-qca/linux/linux-3.3.x/arch/mips/ath79/Kconfig
```kconfig
# Copyright (c) 2013 The Linux Foundation. All rights reserved.
if ATH79

menu "Atheros AR71XX/AR724X/AR913X machine selection"

config ATH79_MACH_ALFA_AP96
	bool "ALFA Network AP96 board support"
	select SOC_AR71XX
	select ATH79_DEV_ETH
	select ATH79_DEV_GPIO_BUTTONS
	select ATH79_DEV_SPI
	select ATH79_DEV_USB

config ATH79_MACH_HORNET_UB
	bool "ALFA Network Hornet-UB board support"
	select SOC_AR933X
	select ATH79_DEV_ETH
	select ATH79_DEV_GPIO_BUTTONS
	select ATH79_DEV_LEDS_GPIO
	select ATH79_DEV_M25P80
	select ATH79_DEV_USB
	select ATH79_DEV_WMAC

config ATH79_MACH_ALFA_NX
	bool "ALFA Network N2/N5 board support"
	select SOC_AR724X
	select ATH79_DEV_AP9X_PCI if PCI
	select ATH79_DEV_ETH
	select ATH79_DEV_GPIO_BUTTONS
	select ATH79_DEV_LEDS_GPIO
	select ATH79_DEV_M25P80

config ATH79_MACH_ALL0258N
	bool "Allnet ALL0258N support"
	select SOC_AR724X
	select ATH79_DEV_AP9X_PCI if PCI
	select ATH79_DEV_ETH
	select ATH79_DEV_GPIO_BUTTONS
	select ATH79_DEV_LEDS_GPIO
	select ATH79_DEV_M25P80

config ATH79_MACH_ALL0315N
	bool "Allnet ALL0315N support"
	select SOC_AR724X
	select ATH79_DEV_AP9X_PCI if PCI
	select ATH79_DEV_ETH
	select ATH79_DEV_GPIO_BUTTONS
	select ATH79_DEV_LEDS_GPIO
	select ATH79_DEV_M25P80

config ATH79_MACH_AP113
	bool "Atheros AP113 board support"
	select SOC_AR724X
	select ATH79_DEV_M25P80
	select ATH79_DEV_PB9X_PCI if PCI
	select ATH79_DEV_GPIO_BUTTONS
	select ATH79_DEV_LEDS_GPIO
	select ATH79_DEV_USB
	select ATH79_DEV_ETH

config ATH79_MACH_AP121
	bool "Atheros AP121 reference board"
	select SOC_AR933X
	select ATH79_DEV_ETH
	select ATH79_DEV_GPIO_BUTTONS
	select ATH79_DEV_LEDS_GPIO
	select ATH79_DEV_M25P80
	select ATH79_DEV_USB
	select ATH79_DEV_WMAC
	help
	  Say 'Y' here if you want your kernel to support the
	  Atheros AP121 reference board.

config ATH79_MACH_AP135
	bool "Atheros AP135 reference board"
	select SOC_QCA955X
	select ATH79_DEV_GPIO_BUTTONS
	select ATH79_DEV_LEDS_GPIO
	select ATH79_DEV_USB
	select ATH79_DEV_WMAC
	select ATH79_DEV_NAND
	select ATH79_DEV_ETH
	help
	  Say 'Y' here if you want your kernel to support the
	  Atheros AP135 reference board.

config ATH79_MACH_AP135_DUAL
	bool "Atheros AP135 Dual reference board"
	select SOC_QCA955X
	select ATH79_DEV_GPIO_BUTTONS
	select ATH79_DEV_LEDS_GPIO
	select ATH79_DEV_SPI
	select ATH79_DEV_USB
	select ATH79_DEV_NAND
	select ATH79_DEV_WMAC
	help
	  Say 'Y' here if you want your kernel to support the
	  Atheros AP135 Dual reference board.

config ATH79_MACH_AP136
	bool "Atheros AP136 reference board"
	select SOC_QCA955X
	select ATH79_DEV_GPIO_BUTTONS
	select ATH79_DEV_LEDS_GPIO
	select ATH79_DEV_SPI
	select ATH79_DEV_USB
	select ATH79_DEV_WMAC
	help
	  Say 'Y' here if you want your kernel to support the
	  Atheros AP136 reference board.

config ATH79_MACH_AP143
	bool "Atheros AP143 reference board"
	select SOC_QCA953X
	select ATH79_DEV_GPIO_BUTTONS
	select ATH79_DEV_LEDS_GPIO
	select ATH79_DEV_SPI
	select ATH79_DEV_USB
	select ATH79_DEV_WMAC
	select ATH79_DEV_ETH
	select ATH79_DEV_M25P80
	help
	  Say 'Y' here if you want your kernel to support the
	  Atheros AP143 reference board.

config ATH79_MACH_AP151
	bool "Atheros AP151 reference board"
	select SOC_QCA956X
	select ATH79_DEV_GPIO_BUTTONS
	select ATH79_DEV_LEDS_GPIO
	select ATH79_DEV_SPI
	select ATH79_DEV_USB
	select ATH79_DEV_WMAC
	select ATH79_DEV_ETH
	select ATH79_DEV_M25P80
	help
	  Say 'Y' here if you want your kernel to support the
	  Atheros AP151 reference board.

config ATH79_MACH_AP147
	bool "Atheros AP147 reference board"
	select SOC_QCA953X
	select ATH79_DEV_GPIO_BUTTONS
	select ATH79_DEV_LEDS_GPIO
	select ATH79_DEV_SPI
	select ATH79_DEV_USB
	select ATH79_DEV_WMAC
	select ATH79_DEV_ETH
	select ATH79_DEV_M25P80
	help
	  Say 'Y' here if you want your kernel to support the
	  Atheros AP147 reference board.

config ATH79_MACH_AP152
	bool "Atheros AP152 reference board"
	select SOC_QCA956X
	select ATH79_DEV_GPIO_BUTTONS
	select ATH79_DEV_LEDS_GPIO
	select ATH79_DEV_SPI
	select ATH79_DEV_USB
	select ATH79_DEV_WMAC
	select ATH79_DEV_ETH
	select ATH79_DEV_M25P80
	help
	  Say 'Y' here if you want your kernel to support the
	  Atheros AP152 reference board.

config ATH79_MACH_AP81
	bool "Atheros AP81 reference board"
	select SOC_AR913X
	select ATH79_DEV_ETH
	select ATH79_DEV_GPIO_BUTTONS
	select ATH79_DEV_LEDS_GPIO
	select ATH79_DEV_M25P80
	select ATH79_DEV_USB
	select ATH79_DEV_WMAC
	select USE_OF
	help
	  Say 'Y' here if you want your kernel to support the
	  Atheros AP81 reference board.

config ATH79_MACH_AP83
	bool "Atheros AP83 board support"
	select SOC_AR913X
	select ATH79_DEV_GPIO_BUTTONS
	select ATH79_DEV_LEDS_GPIO
	select ATH79_DEV_USB
	select ATH79_DEV_WMAC

config ATH79_MACH_AP96
	bool "Atheros AP96 board support"
	select SOC_AR71XX
	select ATH79_DEV_ETH
	select ATH79_DEV_AP9X_PCI if PCI
	select ATH79_DEV_GPIO_BUTTONS
	select ATH79_DEV_LEDS_GPIO
	select ATH79_DEV_M25P80
	select ATH79_DEV_USB

config ATH79_MACH_CUS227
	bool "Qualcomm Atheros CUS227 support"
	select SOC_AR934X
	select ATH79_DEV_ETH
	select ATH79_DEV_GPIO_BUTTONS
	select ATH79_DEV_LEDS_GPIO
	select ATH79_DEV_NAND
	select ATH79_DEV_USB
	select ATH79_DEV_WMAC
	select ATH79_DEV_I2C
	help
	  Say 'Y' here if you want your kernel to support the
	  Qualcomm Atheros CUS227 board.

config ATH79_MACH_DB120
	bool "Atheros DB120 reference board"
	select SOC_AR934X
	select ATH79_DEV_AP9X_PCI if PCI
	select ATH79_DEV_ETH
	select ATH79_DEV_GPIO_BUTTONS
	select ATH79_DEV_LEDS_GPIO
	select ATH79_DEV_M25P80
	select ATH79_DEV_NFC
	select ATH79_DEV_USB
	select ATH79_DEV_WMAC
	help
	  Say 'Y' here if you want your kernel to support the
	  Atheros DB120 reference board.

config ATH79_MACH_DB120_TB388
	bool "Atheros DB120 reference board with TB388 extension"
	select SOC_AR934X
	select ATH79_DEV_AP9X_PCI if PCI
	select ATH79_DEV_AUDIO
	select ATH79_DEV_ETH
	select ATH79_DEV_GPIO_BUTTONS
	select ATH79_DEV_LEDS_GPIO
	select ATH79_DEV_M25P80
	select ATH79_DEV_USB
	select ATH79_DEV_WMAC
	help
	  Say 'Y' here if you want your kernel to support the
	  Atheros DB120 reference board with TB388 extension.

config ATH79_MACH_PB42
	bool "Atheros PB42 board support"
	select SOC_AR71XX
	select ATH79_DEV_ETH
	select ATH79_DEV_GPIO_BUTTONS
	select ATH79_DEV_M25P80

config ATH79_MACH_PB44
	bool "Atheros PB44 reference board"
	select SOC_AR71XX
	select ATH79_DEV_ETH
	select ATH79_DEV_GPIO_BUTTONS
	select ATH79_DEV_LEDS_GPIO
	select ATH79_DEV_SPI
	select ATH79_DEV_USB
	help
	  Say 'Y' here if you want your kernel to support the
	  Atheros PB44 reference board.

config ATH79_MACH_PB92
	bool "Atheros PB92 board support"
	select SOC_AR724X
	select ATH79_DEV_ETH
	select ATH79_DEV_GPIO_BUTTONS
	select ATH79_DEV_LEDS_GPIO
	select ATH79_DEV_PB9X_PCI if PCI
	select ATH79_DEV_USB

config ATH79_MACH_RUBBERDUCK
	bool "Qualcomm-Atheros RubberDuck board support"
	select SOC_QCA955X
	select ATH79_DEV_SPI
	help
	  Say 'Y' here if you want your kernel to support the
	  RubberDuck custom design support.

config ATH79_MACH_GENERIC_DT
	bool "Qualcomm Atheros reference boards with device tree"
	select SOC_AR913X
	select SOC_AR933X
	select SOC_AR934X
	select SOC_QCA955X
	select ATH79_DEV_AP9X_PCI if PCI
	select ATH79_DEV_ETH
	select ATH79_DEV_GPIO_BUTTONS
	select ATH79_DEV_LEDS_GPIO
	select ATH79_DEV_M25P80
	select ATH79_DEV_NFC
	select ATH79_DEV_USB
	select ATH79_DEV_WMAC
	help
	  Say 'Y' here if you want your kernel to support the
	  Qualcomm Atheros reference boards with device tree.

config ATH79_MACH_AW_NR580
	bool "AzureWave AW-NR580 board support"
	select SOC_AR71XX
	select ATH79_DEV_ETH
	select ATH79_DEV_GPIO_BUTTONS
	select ATH79_DEV_LEDS_GPIO
	select ATH79_DEV_M25P80

config ATH79_MACH_WHR_HP_G300N
	bool "Buffalo WHR-HP-G300N board support"
	select SOC_AR724X
	select ATH79_DEV_ETH
	select ATH79_DEV_AP9X_PCI if PCI
	select ATH79_DEV_GPIO_BUTTONS
	select ATH79_DEV_LEDS_GPIO
	select ATH79_DEV_M25P80

config ATH79_MACH_WLAE_AG300N
	bool "Buffalo WLAE-AG300N board support"
	select SOC_AR71XX
	select ATH79_DEV_ETH
	select ATH79_DEV_GPIO_BUTTONS
	select ATH79_DEV_LEDS_GPIO
	select ATH79_DEV_M25P80

config ATH79_MACH_WZR_HP_AG300H
	bool "Buffalo WZR-HP-AG300H board support"
	select SOC_AR71XX
	select ATH79_DEV_ETH
	select ATH79_DEV_GPIO_BUTTONS
	select ATH79_DEV_LEDS_GPIO
	select ATH79_DEV_M25P80
	select ATH79_DEV_USB

config ATH79_MACH_WZR_HP_G300NH
	bool "Buffalo WZR-HP-G300NH board support"
	select SOC_AR913X
	select ATH79_DEV_ETH
	select ATH79_DEV_GPIO_BUTTONS
	select ATH79_DEV_LEDS_GPIO
	select ATH79_DEV_USB
	select ATH79_DEV_WMAC
	select RTL8366_SMI

config ATH79_MACH_WZR_HP_G300NH2
	bool "Buffalo WZR-HP-G300NH2 board support"
	select SOC_AR724X
	select ATH79_DEV_AP9X_PCI if PCI
	select ATH79_DEV_ETH
	select ATH79_DEV_GPIO_BUTTONS
	select ATH79_DEV_LEDS_GPIO
	select ATH79_DEV_M25P80
	select ATH79_DEV_USB

config ATH79_MACH_WZR_HP_G450H
	bool "Buffalo WZR-HP-G450H board support"
	select SOC_AR724X
	select ATH79_DEV_ETH
	select ATH79_DEV_AP9X_PCI if PCI
	select ATH79_DEV_GPIO_BUTTONS
	select ATH79_DEV_LEDS_GPIO
	select ATH79_DEV_M25P80
	select ATH79_DEV_USB

config ATH79_MACH_WP543
	bool "Compex WP543/WPJ543 board support"
	select SOC_AR71XX
	select ATH79_DEV_ETH
	select ATH79_DEV_GPIO_BUTTONS
	select ATH79_DEV_LEDS_GPIO
	select ATH79_DEV_M25P80
	select ATH79_DEV_USB
	select MYLOADER

config ATH79_MACH_WPE72
	bool "Compex WPE72/WPE72NX board support"
	select SOC_AR724X
	select ATH79_DEV_ETH
	select ATH79_DEV_GPIO_BUTTONS
	select ATH79_DEV_LEDS_GPIO
	select ATH79_DEV_M25P80
	select ATH79_DEV_USB
	select MYLOADER

config ATH79_MACH_DIR_600_A1
	bool "D-Link DIR-600 A1/DIR-615 E4 support"
	select SOC_AR724X
	select ATH79_DEV_AP9X_PCI if PCI
	select ATH79_DEV_ETH
	select ATH79_DEV_GPIO_BUTTONS
	select ATH79_DEV_LEDS_GPIO
	select ATH79_DEV_M25P80
	select ATH79_NVRAM

config ATH79_MACH_DIR_615_C1
	bool "D-Link DIR-615 rev. C1 support"
	select SOC_AR913X
	select ATH79_DEV_ETH
	select ATH79_DEV_GPIO_BUTTONS
	select ATH79_DEV_LEDS_GPIO
	select ATH79_DEV_M25P80
	select ATH79_DEV_WMAC
	select ATH79_NVRAM

config ATH79_MACH_DIR_825_B1
	bool "D-Link DIR-825 rev. B1 board support"
	select SOC_AR71XX
	select ATH79_DEV_ETH
	select ATH79_DEV_AP9X_PCI if PCI
	select ATH79_DEV_GPIO_BUTTONS
	select ATH79_DEV_LEDS_GPIO
	select ATH79_DEV_M25P80
	select ATH79_DEV_USB

config ATH79_MACH_EW_DORIN
	bool "embedded wireless Dorin Platform support"
	select SOC_AR933X
	select ATH79_DEV_M25P80
	select ATH79_DEV_GPIO_BUTTONS
	select ATH79_DEV_LEDS_GPIO
	select ATH79_DEV_WMAC
	select ATH79_DEV_ETH
	help
	  Say 'Y' here if you want your kernel to support the
	  Dorin Platform from www.80211.de .

config ATH79_MACH_JA76PF
	bool "jjPlus JA76PF board support"
	select SOC_AR71XX
	select ATH79_DEV_ETH
	select ATH79_DEV_GPIO_BUTTONS
	select ATH79_DEV_LEDS_GPIO
	select ATH79_DEV_M25P80
	select ATH79_DEV_USB

config ATH79_MACH_JWAP003
	bool "jjPlus JWAP003 board support"
	select SOC_AR71XX
	select ATH79_DEV_ETH
	select ATH79_DEV_GPIO_BUTTONS
	select ATH79_DEV_M25P80
	select ATH79_DEV_USB

config ATH79_MACH_WRT160NL
	bool "Linksys WRT160NL board support"
	select SOC_AR913X
	select ATH79_DEV_ETH
	select ATH79_DEV_GPIO_BUTTONS
	select ATH79_DEV_LEDS_GPIO
	select ATH79_DEV_M25P80
	select ATH79_DEV_USB
	select ATH79_DEV_WMAC
	select ATH79_NVRAM

config ATH79_MACH_WRT400N
	bool "Linksys WRT400N board support"
	select SOC_AR71XX
	select ATH79_DEV_ETH
	select ATH79_DEV_AP9X_PCI if PCI
	select ATH79_DEV_GPIO_BUTTONS
	select ATH79_DEV_LEDS_GPIO
	select ATH79_DEV_M25P80

config ATH79_MACH_RB4XX
	bool "MikroTik RouterBOARD 4xx series support"
	select SOC_AR71XX
	select ATH79_DEV_ETH
	select ATH79_DEV_GPIO_BUTTONS
	select ATH79_DEV_LEDS_GPIO
	select ATH79_DEV_USB

config ATH79_MACH_RB750
	bool "MikroTik RouterBOARD 750 support"
	select SOC_AR724X
	select ATH79_DEV_ETH
	select ATH79_DEV_AP9X_PCI if PCI
	select ATH79_DEV_USB
	select ATH79_ROUTERBOOT
	select RLE_DECOMPRESS

config ATH79_MACH_RB2011
	bool "MikroTik RouterBOARD 2011 support"
	select SOC_AR934x
	select ATH79_DEV_ETH
	select ATH79_DEV_NFC
	select ATH79_DEV_WMAC
	select ATH79_ROUTERBOOT

config ATH79_MACH_WNDR3700
	bool "NETGEAR WNDR3700 board support"
	select SOC_AR71XX
	select ATH79_DEV_AP9X_PCI if PCI
	select ATH79_DEV_ETH
	select ATH79_DEV_GPIO_BUTTONS
	select ATH79_DEV_LEDS_GPIO
	select ATH79_DEV_M25P80
	select ATH79_DEV_USB

config ATH79_MACH_WNR2000
	bool "NETGEAR WNR2000 board support"
	select SOC_AR913X
	select ATH79_DEV_ETH
	select ATH79_DEV_GPIO_BUTTONS
	select ATH79_DEV_LEDS_GPIO
	select ATH79_DEV_M25P80
	select ATH79_DEV_WMAC

config ATH79_MACH_OM2P
	bool "OpenMesh OM2P board support"
	select SOC_AR724X
	select SOC_AR933X
	select ATH79_DEV_AP9X_PCI if PCI
	select ATH79_DEV_ETH
	select ATH79_DEV_GPIO_BUTTONS
	select ATH79_DEV_LEDS_GPIO
	select ATH79_DEV_M25P80
	select ATH79_DEV_WMAC

config ATH79_MACH_MR600
	bool "OpenMesh MR600 board support"
	select SOC_AR934X
	select ATH79_DEV_AP9X_PCI if PCI
	select ATH79_DEV_ETH
	select ATH79_DEV_GPIO_BUTTONS
	select ATH79_DEV_LEDS_GPIO
	select ATH79_DEV_M25P80
	select ATH79_DEV_WMAC

config ATH79_MACH_MZK_W04NU
	bool "Planex MZK-W04NU board support"
	select SOC_AR913X
	select ATH79_DEV_ETH
	select ATH79_DEV_GPIO_BUTTONS
	select ATH79_DEV_LEDS_GPIO
	select ATH79_DEV_M25P80
	select ATH79_DEV_USB
	select ATH79_DEV_WMAC

config ATH79_MACH_MZK_W300NH
	bool "Planex MZK-W300NH board support"
	select SOC_AR913X
	select ATH79_DEV_ETH
	select ATH79_DEV_GPIO_BUTTONS
	select ATH79_DEV_LEDS_GPIO
	select ATH79_DEV_M25P80
	select ATH79_DEV_WMAC

config ATH79_MACH_RW2458N
	bool "Redwave RW2458N board support"
	select SOC_AR724X
	select ATH79_DEV_ETH
	select ATH79_DEV_AP9X_PCI if PCI
	select ATH79_DEV_GPIO_BUTTONS
	select ATH79_DEV_LEDS_GPIO
	select ATH79_DEV_M25P80
	select ATH79_DEV_USB

config ATH79_MACH_CAP4200AG
	bool "Senao CAP4200AG support"
	select SOC_AR934X
	select ATH79_DEV_AP9X_PCI if PCI
	select ATH79_DEV_ETH
	select ATH79_DEV_GPIO_BUTTONS
	select ATH79_DEV_LEDS_GPIO
	select ATH79_DEV_M25P80
	select ATH79_DEV_WMAC

config ATH79_MACH_EAP7660D
	bool "Senao EAP7660D support"
	select SOC_AR71XX
	select ATH79_DEV_ETH
	select ATH79_DEV_GPIO_BUTTONS
	select ATH79_DEV_LEDS_GPIO
	select ATH79_DEV_M25P80

config ATH79_MACH_TL_MR11U
	bool "TP-LINK TL-MR11U/TL-MR3040 support"
	select SOC_AR933X
	select ATH79_DEV_ETH
	select ATH79_DEV_GPIO_BUTTONS
	select ATH79_DEV_LEDS_GPIO
	select ATH79_DEV_M25P80
	select ATH79_DEV_USB
	select ATH79_DEV_WMAC

config ATH79_MACH_TL_MR3020
	bool "TP-LINK TL-MR3020 support"
	select SOC_AR933X
	select ATH79_DEV_ETH
	select ATH79_DEV_GPIO_BUTTONS
	select ATH79_DEV_LEDS_GPIO
	select ATH79_DEV_M25P80
	select ATH79_DEV_USB
	select ATH79_DEV_WMAC

config ATH79_MACH_TL_MR3X20
	bool "TP-LINK TL-MR3220/3420 support"
	select SOC_AR724X
	select ATH79_DEV_AP9X_PCI if PCI
	select ATH79_DEV_ETH
	select ATH79_DEV_GPIO_BUTTONS
	select ATH79_DEV_LEDS_GPIO
	select ATH79_DEV_M25P80
	select ATH79_DEV_USB

config ATH79_MACH_TL_WA901ND
	bool "TP-LINK TL-WA901ND/TL-WA7510N support"
	select SOC_AR724X
	select ATH79_DEV_AP9X_PCI if PCI
	select ATH79_DEV_ETH
	select ATH79_DEV_GPIO_BUTTONS
	select ATH79_DEV_LEDS_GPIO
	select ATH79_DEV_M25P80

config ATH79_MACH_TL_WA901ND_V2
	bool "TP-LINK TL-WA901ND v2 support"
	select SOC_AR913X
	select ATH79_DEV_ETH
	select ATH79_DEV_GPIO_BUTTONS
	select ATH79_DEV_LEDS_GPIO
	select ATH79_DEV_M25P80
	select ATH79_DEV_WMAC

config ATH79_MACH_TL_WDR4300
	bool "TP-LINK TL-WDR3600/4300/4310 board support"
	select SOC_AR934X
	select ATH79_DEV_AP9X_PCI if PCI
	select ATH79_DEV_ETH
	select ATH79_DEV_GPIO_BUTTONS
	select ATH79_DEV_LEDS_GPIO
	select ATH79_DEV_M25P80
	select ATH79_DEV_USB
	select ATH79_DEV_WMAC

config ATH79_MACH_TL_WR703N
	bool "TP-LINK TL-WR703N support"
	select SOC_AR933X
	select ATH79_DEV_ETH
	select ATH79_DEV_GPIO_BUTTONS
	select ATH79_DEV_LEDS_GPIO
	select ATH79_DEV_M25P80
	select ATH79_DEV_USB
	select ATH79_DEV_WMAC

config ATH79_MACH_TL_WR741ND
	bool "TP-LINK TL-WR741ND support"
	select SOC_AR724X
	select ATH79_DEV_AP9X_PCI if PCI
	select ATH79_DEV_ETH
	select ATH79_DEV_GPIO_BUTTONS
	select ATH79_DEV_LEDS_GPIO
	select ATH79_DEV_M25P80

config ATH79_MACH_TL_WR741ND_V4
	bool "TP-LINK TL-WR741ND v4 support"
	select SOC_AR933X
	select ATH79_DEV_ETH
	select ATH79_DEV_GPIO_BUTTONS
	select ATH79_DEV_LEDS_GPIO
	select ATH79_DEV_M25P80
	select ATH79_DEV_WMAC

config ATH79_MACH_TL_WR841N_V1
	bool "TP-LINK TL-WR841N v1 support"
	select SOC_AR71XX
	select ATH79_DEV_DSA
	select ATH79_DEV_ETH
	select ATH79_DEV_GPIO_BUTTONS
	select ATH79_DEV_LEDS_GPIO
	select ATH79_DEV_M25P80

config ATH79_MACH_TL_WR841N_V8
	bool "TP-LINK TL-WR841N/ND v8 support"
	select SOC_AR934X
	select ATH79_DEV_ETH
	select ATH79_DEV_GPIO_BUTTONS
	select ATH79_DEV_LEDS_GPIO
	select ATH79_DEV_M25P80
	select ATH79_DEV_WMAC

config ATH79_MACH_TL_WR941ND
	bool "TP-LINK TL-WR941ND support"
	select SOC_AR913X
	select ATH79_DEV_DSA
	select ATH79_DEV_ETH
	select ATH79_DEV_GPIO_BUTTONS
	select ATH79_DEV_LEDS_GPIO
	select ATH79_DEV_M25P80
	select ATH79_DEV_WMAC

config ATH79_MACH_TL_WR1041N_V2
	bool "TP-LINK TL-WR1041N v2 support"
	select SOC_AR934X
	select ATH79_DEV_AP9X_PCI if PCI
	select ATH79_DEV_ETH
	select ATH79_DEV_GPIO_BUTTONS
	select ATH79_DEV_LEDS_GPIO
	select ATH79_DEV_M25P80
	select ATH79_DEV_USB
	select ATH79_DEV_WMAC

config ATH79_MACH_TL_WR1043ND
	bool "TP-LINK TL-WR1043ND support"
	select SOC_AR913X
	select ATH79_DEV_ETH
	select ATH79_DEV_GPIO_BUTTONS
	select ATH79_DEV_LEDS_GPIO
	select ATH79_DEV_M25P80
	select ATH79_DEV_USB
	select ATH79_DEV_WMAC

config ATH79_MACH_TL_WR2543N
	bool "TP-LINK TL-WR2543N/ND support"
	select SOC_AR724X
	select ATH79_DEV_AP9X_PCI if PCI
	select ATH79_DEV_ETH
	select ATH79_DEV_GPIO_BUTTONS
	select ATH79_DEV_LEDS_GPIO
	select ATH79_DEV_M25P80
	select ATH79_DEV_USB

config ATH79_MACH_TEW_632BRP
	bool "TRENDnet TEW-632BRP support"
	select SOC_AR913X
	select ATH79_DEV_ETH
	select ATH79_DEV_GPIO_BUTTONS
	select ATH79_DEV_LEDS_GPIO
	select ATH79_DEV_M25P80
	select ATH79_DEV_WMAC
	select ATH79_NVRAM

config ATH79_MACH_TEW_673GRU
	bool "TRENDnet TEW-673GRU support"
	select SOC_AR71XX
	select ATH79_DEV_AP9X_PCI if PCI
	select ATH79_DEV_ETH
	select ATH79_DEV_GPIO_BUTTONS
	select ATH79_DEV_LEDS_GPIO
	select ATH79_DEV_M25P80
	select ATH79_DEV_USB
	select ATH79_NVRAM

config ATH79_MACH_TEW_712BR
	bool "TRENDnet TEW-712BR support"
	select SOC_AR933X
	select ATH79_DEV_ETH
	select ATH79_DEV_GPIO_BUTTONS
	select ATH79_DEV_LEDS_GPIO
	select ATH79_DEV_M25P80
	select ATH79_DEV_WMAC
	select ATH79_NVRAM

config ATH79_MACH_UBNT
	bool "Ubiquiti AR71xx based boards support"
	select SOC_AR71XX
	select ATH79_DEV_ETH
	select ATH79_DEV_GPIO_BUTTONS
	select ATH79_DEV_LEDS_GPIO
	select ATH79_DEV_M25P80
	select ATH79_DEV_USB

config ATH79_MACH_UBNT_XM
	bool "Ubiquiti Networks XM (rev 1.0) board"
	select SOC_AR724X
	select ATH79_DEV_AP9X_PCI if PCI
	select ATH79_DEV_ETH
	select ATH79_DEV_GPIO_BUTTONS
	select ATH79_DEV_LEDS_GPIO
	select ATH79_DEV_M25P80
	select ATH79_DEV_USB
	help
	  Say 'Y' here if you want your kernel to support the
	  Ubiquiti Networks XM (rev 1.0) board.

config ATH79_MACH_ZCN_1523H
	bool "Zcomax ZCN-1523H support"
	select SOC_AR724X
	select ATH79_DEV_AP9X_PCI if PCI
	select ATH79_DEV_ETH
	select ATH79_DEV_GPIO_BUTTONS
	select ATH79_DEV_LEDS_GPIO
	select ATH79_DEV_M25P80

config ATH79_MACH_NBG460N
	bool "Zyxel NBG460N/550N/550NH board support"
	select SOC_AR913X
	select ATH79_DEV_ETH
	select ATH79_DEV_GPIO_BUTTONS
	select ATH79_DEV_LEDS_GPIO
	select ATH79_DEV_M25P80
	select ATH79_DEV_WMAC

endmenu

config SOC_AR71XX
	select USB_ARCH_HAS_EHCI
	select USB_ARCH_HAS_OHCI
	select HW_HAS_PCI
	def_bool n

config SOC_AR724X
	select USB_ARCH_HAS_EHCI
	select USB_ARCH_HAS_OHCI
	select HW_HAS_PCI
	select PCI_AR724X if PCI
	def_bool n

config SOC_AR913X
	select USB_ARCH_HAS_EHCI
	def_bool n

config SOC_AR933X
	select USB_ARCH_HAS_EHCI
	def_bool n

config SOC_AR934X
	select USB_ARCH_HAS_EHCI
	select HW_HAS_PCI
	select PCI_AR724X if PCI
	def_bool n

config SOC_QCA953X
	select USB_ARCH_HAS_EHCI if USB
	select HW_HAS_PCI
	select PCI_AR724X if PCI
	def_bool n

config SOC_QCA955X
	select USB_ARCH_HAS_EHCI
	select HW_HAS_PCI
	select PCI_AR724X if PCI
	def_bool n

config SOC_QCA956X
	select USB_ARCH_HAS_EHCI
	select HW_HAS_PCI
	select PCI_AR724X if PCI
	def_bool n

config ATH79_DEV_AP9X_PCI
	select ATH79_PCI_ATH9K_FIXUP
	def_bool n

config ATH79_DEV_AUDIO
	def_bool n

config ATH79_DEV_DSA
	def_bool n

config ATH79_DEV_ETH
	def_bool n

config ATH79_DEV_M25P80
	select ATH79_DEV_SPI
	def_bool n

config ATH79_DEV_DSA
	def_bool n

config ATH79_DEV_ETH
	def_bool n

config ATH79_DEV_GPIO_BUTTONS
	def_bool n

config ATH79_DEV_LEDS_GPIO
	def_bool n

config ATH79_DEV_NFC
	depends on (SOC_AR934X)
	def_bool n

config ATH79_DEV_NAND
	select ATH79_NAND_CALDATA_FIXUP
	def_bool n

config ATH79_DEV_SPI
	def_bool n

config ATH79_DEV_I2C
	def_bool n

config ATH79_DEV_USB
	def_bool n

config ATH79_DEV_WMAC
	depends on (SOC_AR913X || SOC_AR933X || SOC_AR934X || SOC_QCA953X || SOC_QCA955X || SOC_QCA956X)
	def_bool n

config ATH79_NAND_CALDATA_FIXUP
	def_bool n

config ATH79_NVRAM
	def_bool n

config ATH79_PCI_ATH9K_FIXUP
	def_bool n

config ATH79_ROUTERBOOT
	def_bool n

config PCI_AR724X
	def_bool n

endif
```
