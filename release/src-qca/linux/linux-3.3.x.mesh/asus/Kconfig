## release/src-qca/linux/linux-3.3.x/qca/Kconfig
```kconfig
menu "QCA Proprietary software"

####################
# qca wifi driver  #
####################
source "drivers/net/wireless/qca/Kconfig"
endmenu
```
